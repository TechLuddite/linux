## Documentation/devicetree/bindings/input/ayntec,odin2-gamepad.yaml
```yaml
# SPDX-License-Identifier: (GPL-2.0-only OR BSD-2-Clause)
%YAML 1.2
---
$id: http://devicetree.org/schemas/input/ayntec,odin2-gamepad.yaml#
$schema: http://devicetree.org/meta-schemas/core.yaml#

title: AYN Odin 2 gamepad controller

maintainers:
  - Perry Dale <techluddite@outlook.com>

description:
  The built-in controls of AYN Odin 2 family handhelds (D-pad, face and
  shoulder buttons, two analog sticks and two analog triggers) are scanned by
  a microcontroller. The microcontroller streams state reports to the SoC
  over a UART at 115200 baud. The rear grip buttons are not connected to the
  microcontroller and are wired to SoC GPIOs instead.

allOf:
  - $ref: /schemas/serial/serial-peripheral-props.yaml#

properties:
  compatible:
    const: ayntec,odin2-gamepad

  vdd-supply:
    description: Supply of the gamepad microcontroller.

  enable-gpios:
    maxItems: 1
    description: GPIO that holds the microcontroller in reset when inactive.

  grip-gpios:
    minItems: 1
    items:
      - description: Left rear grip button
      - description: Right rear grip button

required:
  - compatible
  - vdd-supply
  - enable-gpios

unevaluatedProperties: false

examples:
  - |
    #include <dt-bindings/gpio/gpio.h>

    serial {
        mcu {
            compatible = "ayntec,odin2-gamepad";
            vdd-supply = <&vreg_bob2>;
            enable-gpios = <&tlmm 12 GPIO_ACTIVE_HIGH>;
            grip-gpios = <&tlmm 57 GPIO_ACTIVE_LOW>,
                         <&tlmm 58 GPIO_ACTIVE_LOW>;
        };
    };
```

## Documentation/devicetree/bindings/leds/issi,is31fl3236.yaml
```yaml
# SPDX-License-Identifier: (GPL-2.0-only OR BSD-2-Clause)
%YAML 1.2
---
$id: http://devicetree.org/schemas/leds/issi,is31fl3236.yaml#
$schema: http://devicetree.org/meta-schemas/core.yaml#

title: ISSI IS31FL32xx and Si-En SN32xx LED controllers

maintainers:
  - Perry Dale <techluddite@outlook.com>

description: |
  The IS31FL32xx/SN32xx family of LED controllers are I2C devices with
  multiple constant-current channels, each with independent 256-level PWM
  control (4096-level on IS31FL3293). Each LED is represented as a sub-node
  of the device.

  For more product information please see the links below:
    https://www.issi.com/US/product-analog-fxled-driver.shtml
    https://www.si-en.com/product.asp?parentid=890

properties:
  compatible:
    enum:
      - heroic,htr3212
      - issi,is31fl3216
      - issi,is31fl3218
      - issi,is31fl3235
      - issi,is31fl3236
      - issi,is31fl3236a
      - issi,is31fl3293
      - si-en,sn3216
      - si-en,sn3218

  reg:
    maxItems: 1

  "#address-cells":
    const: 1

  "#size-cells":
    const: 0

  shutdown-gpios:
    maxItems: 1
    description:
      GPIO connected to the SDB pin. Asserting it shuts the controller down.

  vdd-supply:
    description: Supply of the controller.

  issi,22khz-pwm:
    type: boolean
    description:
      Select 22 kHz PWM output frequency instead of the default 3 kHz.
      Only supported by controllers with an output frequency register.

patternProperties:
  "^led@[1-9a-f][0-9a-f]*$":
    type: object
    $ref: common.yaml#
    unevaluatedProperties: false

    properties:
      reg:
        description: LED channel number (1..N).
        minimum: 1
        maximum: 36

      led-max-microamp:
        description: Maximum LED current. Only used by IS31FL3293.

    required:
      - reg

required:
  - compatible
  - reg
  - "#address-cells"
  - "#size-cells"

allOf:
  - if:
      properties:
        compatible:
          contains:
            const: heroic,htr3212
    then:
      patternProperties:
        "^led@[1-9a-f][0-9a-f]*$":
          properties:
            reg:
              maximum: 12

additionalProperties: false

examples:
  - |
    #include <dt-bindings/gpio/gpio.h>
    #include <dt-bindings/leds/common.h>

    i2c {
        #address-cells = <1>;
        #size-cells = <0>;

        led-controller@3c {
            compatible = "heroic,htr3212";
            reg = <0x3c>;
            #address-cells = <1>;
            #size-cells = <0>;
            shutdown-gpios = <&tlmm 55 GPIO_ACTIVE_LOW>;
            vdd-supply = <&vdd_3v3>;

            led@1 {
                reg = <1>;
                color = <LED_COLOR_ID_RED>;
            };
        };
    };

  - |
    i2c {
        #address-cells = <1>;
        #size-cells = <0>;

        led-controller@3c {
            compatible = "issi,is31fl3236";
            reg = <0x3c>;
            #address-cells = <1>;
            #size-cells = <0>;

            led@1 {
                reg = <1>;
                label = "EB:blue:usr0";
            };

            led@2 {
                reg = <2>;
                label = "EB:blue:usr1";
            };
        };
    };
```
